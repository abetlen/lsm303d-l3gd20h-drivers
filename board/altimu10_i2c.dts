/dts-v1/;
/plugin/;

/ {
	compatible = "brcm,bcm2708";

	fragment@0 {
		target = <&i2c1>;
		__overlay__ {
			#address-cells = <1>;
			#size-cells = <0>;
			status = "okay";

			lsm303d: lsm303d@1D {
				compatible = "st,lsm303d";
				reg = <0x1D>;
				status = "disable";
			};
			l3gd20h: l3gd20h@6B {
				compatible = "st,l3gd20h";
				reg = <0x6B>;
				status = "disable";
			};
		};
	};
	__overrides__ {
		lsm303d_enable = <&lsm303d>,"status";
		l3gd20h_enable = <&l3gd20h>,"status";
	};
};
